/*---------------------------------------------------------------------*/
/* --- STC MCU Limited ------------------------------------------------*/
/* --- STC 1T Series MCU Demo Programme -------------------------------*/
/* --- Mobile: (86)13922805190 ----------------------------------------*/
/* --- Fax: 86-0513-55012956,55012947,55012969 ------------------------*/
/* --- Tel: 86-0513-55012928,55012929,55012966 ------------------------*/
/* --- Web: www.STCAI.com ---------------------------------------------*/
/* --- BBS: www.STCAIMCU.com  -----------------------------------------*/
/* --- QQ:  800003751 -------------------------------------------------*/
/* 如果要在程序中使用此代码,请在程序中注明使用了STC的资料及程序        */
/*---------------------------------------------------------------------*/


/*************  功能说明    **************

本例程基于STC32G12K128为主控芯片的实验箱9进行编写测试.

利用高级PWMA/PWMB中断实现定时器功能.

定时周期 = ((PWMx_PSCR + 1) * (PWMx_ARR + 1)) / SYSclk.

下载时, 选择时钟 24MHZ (用户可自行修改频率).

******************************************/

#include "..\comm\STC32G.h"
#include "intrins.h"

#define     MAIN_Fosc       24000000L   //定义主时钟

typedef     unsigned char   u8;
typedef     unsigned int    u16;
typedef     unsigned long   u32;

/****************************** 用户定义宏 ***********************************/


/*****************************************************************************/

void PWMA_Timer(u32 timer);
void PWMB_Timer(u32 timer);

/******************** 主函数 **************************/
void main(void)
{
    WTST = 0;  //设置程序指令延时参数，赋值为0可将CPU执行指令的速度设置为最快
    EAXFR = 1; //扩展寄存器(XFR)访问使能
    CKCON = 0; //提高访问XRAM速度

    P0M1 = 0x30;   P0M0 = 0x30;   //设置P0.4、P0.5为漏极开路(实验箱加了上拉电阻到3.3V)
    P1M1 = 0x30;   P1M0 = 0x30;   //设置P1.4、P1.5为漏极开路(实验箱加了上拉电阻到3.3V)
    P2M1 = 0x3c;   P2M0 = 0x3c;   //设置P2.2~P2.5为漏极开路(实验箱加了上拉电阻到3.3V)
    P3M1 = 0x50;   P3M0 = 0x50;   //设置P3.4、P3.6为漏极开路(实验箱加了上拉电阻到3.3V)
    P4M1 = 0x3c;   P4M0 = 0x3c;   //设置P4.2~P4.5为漏极开路(实验箱加了上拉电阻到3.3V)
    P5M1 = 0x0c;   P5M0 = 0x0c;   //设置P5.2、P5.3为漏极开路(实验箱加了上拉电阻到3.3V)
    P6M1 = 0xff;   P6M0 = 0xff;   //设置为漏极开路(实验箱加了上拉电阻到3.3V)
    P7M1 = 0x00;   P7M0 = 0x00;   //设置为准双向口

    PWMA_Timer(1000);		//1ms
    PWMB_Timer(5000000);	//5s

    P40 = 0;		//给LED供电
    EA = 1;     //打开总中断

    while (1);
}

//========================================================================
// 函数: void PWMA_Timer(u32 timer)
// 描述: PWMA配置函数.
// 参数: None
// 返回: none.
// 版本: V1.0, 2021-02-08
//========================================================================
void PWMA_Timer(u32 timer)
{
	u16 psc=1;
		
	timer *= (MAIN_Fosc / 1000000);	//timer us
	while(timer > 65535L)
	{
		psc *= 2;
		timer >>= 1;
	}
	timer--;
	psc--;
	
	//定时周期 = ((PWMx_PSCR + 1) * (PWMx_ARR + 1)) / SYSclk
    PWMA_ARRH = (u8)(timer >> 8); //设置周期时间
    PWMA_ARRL = (u8)(timer);
    PWMA_PSCRH = (u8)(psc >> 8);  //设置预分频器
    PWMA_PSCRL = (u8)(psc);

	PWMA_IER = 0x01; // 使能中断
	PWMA_CR1 |= 0x81; //使能ARR预装载，开始计时
}

//========================================================================
// 函数: void PWMB_Timer(u32 timer)
// 描述: PWMB配置函数.
// 参数: None
// 返回: none.
// 版本: V1.0, 2021-02-08
//========================================================================
void PWMB_Timer(u32 timer)
{
	u16 psc=1;
	
	timer *= (MAIN_Fosc / 1000000);	//timer us
	while(timer > 65535L)
	{
		psc *= 2;
		timer >>= 1;
	}
	timer--;
	psc--;
	
	//定时周期 = ((PWMx_PSCR + 1) * (PWMx_ARR + 1)) / SYSclk
    PWMB_ARRH = (u8)(timer >> 8); //设置周期时间
    PWMB_ARRL = (u8)(timer);
    PWMB_PSCRH = (u8)(psc >> 8);  //设置预分频器
    PWMB_PSCRL = (u8)(psc);

	PWMB_IER = 0x01; // 使能中断
	PWMB_CR1 |= 0x81; //使能ARR预装载，开始计时
}

//========================================================================
// 函数: PWMA_ISR() interrupt 26
// 描述: PWMA中断函数.
// 参数: None
// 返回: none.
// 版本: V1.0, 2020-12-04
//========================================================================
void PWMA_ISR() interrupt 26
{
	PWMA_SR1 = 0;
	P60 = ~P60;
}

//========================================================================
// 函数: PWMB_ISR() interrupt 27
// 描述: PWMB中断函数.
// 参数: None
// 返回: none.
// 版本: V1.0, 2020-12-04
//========================================================================
void PWMB_ISR() interrupt 27
{
	PWMB_SR1 = 0;
	P64 = ~P64;
}

