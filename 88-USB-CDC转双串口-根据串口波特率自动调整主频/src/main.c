/*---------------------------------------------------------------------*/
/* --- STC MCU Limited ------------------------------------------------*/
/* --- STC 1T Series MCU Demo Programme -------------------------------*/
/* --- Mobile: (86)13922805190 ----------------------------------------*/
/* --- Fax: 86-0513-55012956,55012947,55012969 ------------------------*/
/* --- Tel: 86-0513-55012928,55012929,55012966 ------------------------*/
/* --- Web: www.STCAI.com ---------------------------------------------*/
/* --- BBS: www.STCAIMCU.com  -----------------------------------------*/
/* --- QQ:  800003751 -------------------------------------------------*/
/* 如果要在程序中使用此代码,请在程序中注明使用了STC的资料及程序        */
/*---------------------------------------------------------------------*/

/*************  功能说明    **************

本例程基于STC32G12K128为主控芯片的实验箱进行编写测试.

使用USB线连接核心板USB接口与电脑;

MCU通过USB CDC(Communication Device Class)协议识别为2个串口设备;

其中CDC1虚拟串口，通过TXD3_2(P5.1), RXD3_2(P5.0)接口收发; CDC2虚拟串口，通过TXD2_2(P4.7), RXD2_2(P4.6)接口收发。
短接实验箱上的J7、J8跳线即可进行USB转双串口间相互通信。

可以通过“config.h”里面的“Dynamic_Frequency”定义启动根据串口通信波特率动态调整IRC主频，减少波特率计算误差。
使能后可根据串口波特率动态调整主频以提高串口通信精确度；
不过一个通道波特率调整引发主频变化后，另一个通道的波特率计算就会受影响；
不需要此功能可屏蔽这个定义。

串口通信最高波特率可达10Mbps.

按P3.2口按键手动断开输出供电(输出电源从实验箱Q11三极管C极取电)，松开按键恢复供电。

下载时, 选择时钟 24MHZ (用户可自行修改频率)。

******************************************/

#include "stc.h"
#include "usb.h"
#include "uart.h"
#include "timer.h"

unsigned long MAIN_Fosc = 24000000L;    //定义默认主时钟

bit Key_Flag;
u8  Key_cnt;

void sys_init();
void KeyResetScan(void);

void main()
{
    sys_init();
    uart_init();
    timer_init();
    usb_init();
    EA = 1;
    
    while (1)
    {
        uart_polling();
        if(f1ms)
        {
            f1ms = 0;
            KeyResetScan();
        }
    }
}

void sys_init()
{
    WTST = 0;  //设置程序指令延时参数，赋值为0可将CPU执行指令的速度设置为最快
    EAXFR = 1; //扩展寄存器(XFR)访问使能
    CKCON = 0; //提高访问XRAM速度

    P0M1 = 0x00;   P0M0 = 0x00;   //设置为准双向口
    P1M1 = 0x00;   P1M0 = 0x00;   //设置为准双向口
//    P1M1 = 0x00;   P1M0 = 0x40;   //设置为准双向口, P1.6设置位推挽输出(IRC主频输出验证)
    P2M1 = 0x00;   P2M0 = 0x00;   //设置为准双向口
    P3M1 = 0x00;   P3M0 = 0x00;   //设置为准双向口
    P4M1 = 0x00;   P4M0 = 0x00;   //设置为准双向口
    P5M1 = 0x00;   P5M0 = 0x00;   //设置为准双向口
    P6M1 = 0x00;   P6M0 = 0x00;   //设置为准双向口
    P7M1 = 0x00;   P7M0 = 0x00;   //设置为准双向口
    
//    MCLKOCR = 0x81; //主时钟频率1分频输出到P1.6口(IRC主频输出验证)

    S3_S = 1;       //UART3(RxD3_2/P5.0, TxD3_2/P5.1)
    S2_S = 1;       //UART2(RxD2_2/P4.6, TxD2_2/P4.7)
    
    DOWNLOAD = 1;       //P3.2口拉高
    SVCC_E = 0;         //SVCC输出使能(P4.0)
    LED_POWER = 0;      //输出指示灯(P6.7)
}

#define SVCC_ON()           SVCC_E = 0; P5M1 &= ~0x03   //P5.0,P5.1设置准双向模式
#define SVCC_OFF()          SVCC_E = 1; P5M1 |= 0x03   //P5.0,P5.1设置高阻输入模式

//========================================================================
// 函数: void KeyResetScan(void)
// 描述: P3.2口按键触发S-VCC断电。
// 参数: none.
// 返回: none.
// 版本: VER1.0
// 日期: 2022-12-06
// 备注: 
//========================================================================
void KeyResetScan(void)
{
    if(!P32)
    {
        if(!Key_Flag)
        {
            Key_cnt++;
            if(Key_cnt >= 50)		//连续50ms有效按键检测
            {
                Key_Flag = 1;		//设置按键状态，防止重复触发

                SVCC_OFF();
            }
        }
    }
    else
    {
        Key_cnt = 0;
        if(Key_Flag)
        {
            SVCC_ON();
            Key_Flag = 0;
        }
    }
}
