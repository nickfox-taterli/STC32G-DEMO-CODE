/*---------------------------------------------------------------------*/
/* --- STC MCU Limited ------------------------------------------------*/
/* --- STC 1T Series MCU Demo Programme -------------------------------*/
/* --- Mobile: (86)13922805190 ----------------------------------------*/
/* --- Fax: 86-0513-55012956,55012947,55012969 ------------------------*/
/* --- Tel: 86-0513-55012928,55012929,55012966 ------------------------*/
/* --- Web: www.STCAI.com ---------------------------------------------*/
/* --- BBS: www.STCAIMCU.com  -----------------------------------------*/
/* --- QQ:  800003751 -------------------------------------------------*/
/* 如果要在程序中使用此代码,请在程序中注明使用了STC的资料及程序            */
/*---------------------------------------------------------------------*/

#include "adc.h"
#include "app_rtc.h"
#include "app_display.h"

/*************** 功能说明 ****************

左边4位LED显示时间(小时,分钟).

******************************************/


//========================================================================
//                               本地常量声明	
//========================================================================


//========================================================================
//                               本地变量声明
//========================================================================

u8  usrHour,usrMinute,usrSecond; //RTC变量
u8  msecond;

//========================================================================
//                               本地函数声明
//========================================================================

void DisplayRTC(void);
void RTC(void);

//========================================================================
//                            外部函数和变量声明
//========================================================================


//========================================================================
// 函数: RTC_init
// 描述: 用户初始化程序.
// 参数: None.
// 返回: None.
// 版本: V1.0, 2020-09-28
//========================================================================
void RTC_init(void)
{
    usrHour   = 12;    //初始化时间值
    usrMinute = 0;
    usrSecond = 0;
    DisplayRTC();
}

//========================================================================
// 函数: Sample_RTC
// 描述: 用户应用程序.
// 参数: None.
// 返回: None.
// 版本: V1.0, 2020-09-23
//========================================================================
void Sample_RTC(void)
{
    if(++msecond & 1)   //1秒到
    {
        RTC();
    }
    DisplayRTC();
}

/********************** 显示时钟函数 ************************/
void DisplayRTC(void)
{
    if(usrHour >= 10)  LED8[0] = usrHour / 10;
    else            LED8[0] = DIS_BLACK;
    LED8[1] = usrHour % 10;
    LED8[2] = usrMinute / 10;
    LED8[3] = usrMinute % 10;
    if(msecond & 1)      LED8[1] |= DIS_DOT; //小时后的小数点做秒闪
}

/********************** RTC演示函数 ************************/
void RTC(void)
{
    if(++usrSecond >= 60)
    {
        usrSecond = 0;
        if(++usrMinute >= 60)
        {
            usrMinute = 0;
            if(++usrHour >= 24)    usrHour = 0;
        }
    }
}
